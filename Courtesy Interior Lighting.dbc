VERSION ""

NS_ :

BS_:

BU_: Interior_Lighting_Control Door_Control_Unit

BO_ 257 Light_Message: 1 Interior_Lighting_Control
 SG_ Center_Interior_Light_Status : 0|8@1+ (1,0) [0|1] "" Vector__XXX

BO_ 256 Door_Message: 2 Door_Control_Unit
 SG_ Front_Right_Door_Status : 8|8@1+ (1,0) [0|1] ""  Interior_Lighting_Control
 SG_ Front_Left_Door_Status : 0|8@1+ (1,0) [0|1] ""  Interior_Lighting_Control

EV_ Env_Switch: 0 [0|1] "" 0 1 DUMMY_NODE_VECTOR0 Vector__XXX;

BA_DEF_  "BusType" STRING ;
BA_DEF_DEF_  "BusType" "CAN";
